## components/darksky/Kconfig.projbuild
```kconfig
menu "Darksky Configuration"

config PLACE_NAME
    string "Place name"
    default "Garderen, The Netherlands"

config LATITUDE
    string "Latitude"
    default "52.234361"

config LONGITUDE
    string "Longitude"
    default "5.716846"

config DARKSKY_API_KEY
    string "Darksky API KEY"
    default "myapikey"
    help
	You can get an api key here: https://darksky.net/dev 1,000 Calls Per Day for Free

endmenu
```

## main/Kconfig.projbuild
```kconfig
# put here your custom config value
menu "WiFi Configuration"
config ESP_WIFI_SSID
    string "WiFi SSID"
    default "myssid"
    help
	SSID (network name) for the project to connect to.

config ESP_WIFI_PASSWORD
    string "WiFi Password"
    default "mypassword"
    help
	WiFi password (WPA or WPA2) for the project to use.

config ESP_DNS_NAME
    string "DNS Name"
    default "myweatherdisplay"
    help
	DNS name for the project to use in the network.


config OTA_URL
    string "OTA URL"
    default "http://192.168.178.176:8080/build/e-paper-weatherdisplay.bin"
    help
	URL for getting the bin file over the air using http.
endmenu
```
